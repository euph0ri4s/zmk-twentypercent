## boards/shields/chockminimal/Kconfig.defconfig
```kconfig
if SHIELD_CHOCKMINIMAL_RIGHT

config ZMK_KEYBOARD_NAME
  default "ChockMinimal"

config ZMK_SPLIT
  default y

config ZMK_SPLIT_BLE_ROLE_CENTRAL
  default y

endif

if SHIELD_CHOCKMINIMAL_LEFT

config ZMK_SPLIT
  default y

endif
```

## boards/shields/chockminimal/Kconfig.shield
```kconfig
config SHIELD_CHOCKMINIMAL_LEFT
  def_bool $(shields_list_contains,chockminimal_left)

config SHIELD_CHOCKMINIMAL_RIGHT
  def_bool $(shields_list_contains,chockminimal_right)
```

## boards/shields/twentypercent/Kconfig.defconfig
```kconfig
if SHIELD_TWENTYPERCENT_RIGHT_STANDALONE

config ZMK_KEYBOARD_NAME
  default "TwentyPercent"

config ZMK_SPLIT_BLE_ROLE_CENTRAL
  default y

endif

if SHIELD_TWENTYPERCENT_LEFT

config ZMK_SPLIT
  default y

endif
```

## boards/shields/twentypercent/Kconfig.shield
```kconfig
config SHIELD_TWENTYPERCENT_LEFT
  def_bool $(shields_list_contais,twentypercent_left)

config SHIELD_TWENTYPERCENT_RIGHT_STANDALONE
  def_bool $(shields_list_contais,twentypercent_right_standalone)
```
