/*
 * Copyright (c) 2024 The ZMK Contributors
 * SPDX-License-Identifier: MIT
 * 
 * Charybdis right keyboard - Standalone mode (acts as central)
 * Processes trackball input locally
 */

#include "twentypercent_right_common.dtsi"
#include "twentypercent_trackball_processors.dtsi"

/ {
    trackball_listener: trackball_listener {
        compatible = "zmk,input-listener";
        status = "okay";
        device = <&trackball>;

        TWENTYPERCENT_TRACKBALL_PROCESSORS
    };
};
